## app/boards/shields/kyria/Kconfig.defconfig
```kconfig
if SHIELD_KYRIA_LEFT || SHIELD_KYRIA_REV2_LEFT || SHIELD_KYRIA_REV3_LEFT

config ZMK_KEYBOARD_NAME
    default "Kyria"

config ZMK_SPLIT_ROLE_CENTRAL
    default y

# Send HID indicator to peripherals
config ZMK_SPLIT_PERIPHERAL_HID_INDICATORS
    default y

endif # End for the left role

if SHIELD_KYRIA_RIGHT || SHIELD_KYRIA_REV2_RIGHT || SHIELD_KYRIA_REV3_RIGHT

# Send HID indicator to peripherals
config ZMK_SPLIT_PERIPHERAL_HID_INDICATORS
    default y

config ZMK_HID_INDICATORS
    default y

endif # End for the Right role

if SHIELD_KYRIA

config ZMK_SPLIT
    default y

if ZMK_DISPLAY

config I2C
    default y

config SSD1306
    default y

endif # ZMK_DISPLAY

if LVGL

config LV_Z_VDB_SIZE
    default 64

config LV_DPI_DEF
    default 148

config LV_Z_BITS_PER_PIXEL
    default 1

choice LV_COLOR_DEPTH
    default LV_COLOR_DEPTH_1
endchoice

endif # LVGL

endif # End for the SHIELD_KYRIA
```

## app/west.yml
```yaml
manifest:
  remotes:
    - name: zephyrproject-rtos
      url-base: https://github.com/zephyrproject-rtos
    - name: zmkfirmware
      url-base: https://github.com/zmkfirmware
    - name: nice-view-kyria
      url-base: https://github.com/MatthewWinnan
    - name: urob
      url-base: https://github.com/urob
  projects:
    - name: zephyr
      remote: zmkfirmware
      revision: v3.5.0+zmk-fixes
      clone-depth: 1
      import:
        name-blocklist:
          - ci-tools
          - hal_altera
          - hal_cypress
          - hal_infineon
          - hal_microchip
          - hal_nxp
          - hal_openisa
          - hal_silabs
          - hal_xtensa
          - hal_st
          - hal_ti
          - loramac-node
          - mcuboot
          - mcumgr
          - net-tools
          - openthread
          - edtt
          - trusted-firmware-m
    - name: nanopb
      revision: 8c60555d6277a0360c876bd85d491fc4fb0cd74a
      path: modules/lib/nanopb
      remote: zmkfirmware
    - name: zmk-studio-messages
      revision: 6cb4c283e76209d59c45fbcb218800cd19e9339d
      path: modules/msgs/zmk-studio-messages
      remote: zmkfirmware
    - name: zmk-auto-layer
      remote: urob
      revision: main

        # My custom nice view for the kyria
    - name: kyria_nice_view
      remote: nice-view-kyria
      path: app/boards/shields/nice-view-kyria
      revision: main

  self:
    west-commands: scripts/west-commands.yml
```

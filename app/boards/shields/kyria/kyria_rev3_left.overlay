/*
 * Copyright (c) 2023 The ZMK Contributors
 *
 * SPDX-License-Identifier: MIT
 */

#include "kyria_rev3.dtsi"

/{
  model = "kyria_rev3_left";
  compatible = "kyria_rev3_left";

  underglow-layer {
        compatible  = "zmk,underglow-layer";
        pixel-lookup = <40>, <41>, <42>, <43>, <44>, <24>, <25>, <26>, <27>, <28>, <29>,  <30>, <31>, <12>,
                    <13>, <14>, <15>,  <16>, <17>, <0>, <1>, <2>, <3>, <4>,  <5>;
    };
};

&kscan0 {
    row-gpios
    = <&pro_micro 4 (GPIO_ACTIVE_HIGH | GPIO_PULL_DOWN)>
    , <&pro_micro 5 (GPIO_ACTIVE_HIGH | GPIO_PULL_DOWN)>
    , <&pro_micro 6 (GPIO_ACTIVE_HIGH | GPIO_PULL_DOWN)>
    , <&pro_micro 7 (GPIO_ACTIVE_HIGH | GPIO_PULL_DOWN)>
    ;
    col-gpios
    = <&pro_micro 10 GPIO_ACTIVE_HIGH>
    , <&pro_micro 16 GPIO_ACTIVE_HIGH>
    , <&pro_micro 14 GPIO_ACTIVE_HIGH>
    , <&pro_micro 15 GPIO_ACTIVE_HIGH>
    , <&pro_micro 18 GPIO_ACTIVE_HIGH>
    , <&pro_micro 19 GPIO_ACTIVE_HIGH>
    , <&pro_micro 8 GPIO_ACTIVE_HIGH>
    ;
};

&left_encoder {
    status = "okay";
};
